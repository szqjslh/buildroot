## configs/szqzj_x86_64_bios_defconfig
```kconfig
# CPU 架构
BR2_x86_64=y

# 使用 musl c 库
BR2_TOOLCHAIN_BUILDROOT_MUSL=y
# musl c 库不需要多余的wchar设置

# 启用ccache用作多次构建的加速
BR2_CCACHE=y
BR2_CCACHE_DIR="$(TOPDIR)/dl/.buildroot-ccache"

# 系统
BR2_TARGET_GENERIC_GETTY_PORT="tty1"
BR2_ROOTFS_DEVICE_CREATION_DYNAMIC_EUDEV=y
# 启用 NLS 支持
BR2_SYSTEM_ENABLE_NLS=y
# 安装 timezone 文件
BR2_TARGET_TZ_INFO=y
BR2_TARGET_LOCALTIME="Hongkong"
# 合并系统文件到 /usr
BR2_ROOTFS_MERGED_USR=y




# 用于创建可启动的镜像
BR2_PACKAGE_HOST_GENIMAGE=y

# 引导程序
BR2_TARGET_GRUB2=y

# 文件系统,镜像
BR2_TARGET_ROOTFS_EXT2=y
BR2_TARGET_ROOTFS_EXT2_4=y
BR2_TARGET_ROOTFS_EXT2_SIZE="120M"
# BR2_TARGET_ROOTFS_TAR is not set
BR2_ROOTFS_POST_BUILD_SCRIPT="board/pc/post-build.sh"
BR2_ROOTFS_POST_IMAGE_SCRIPT="support/scripts/genimage.sh"
BR2_ROOTFS_POST_SCRIPT_ARGS="-c board/pc/genimage-bios.cfg"

# Linux 内核头文件应该和使用的内核相同
BR2_PACKAGE_HOST_LINUX_HEADERS_CUSTOM_5_10=y

# Linux 内核
BR2_LINUX_KERNEL=y
BR2_LINUX_KERNEL_CUSTOM_VERSION=y
BR2_LINUX_KERNEL_CUSTOM_VERSION_VALUE="5.10.41"
BR2_LINUX_KERNEL_USE_CUSTOM_CONFIG=y
BR2_LINUX_KERNEL_CUSTOM_CONFIG_FILE="board/pc/linux.config"
BR2_LINUX_KERNEL_INSTALL_TARGET=y
BR2_LINUX_KERNEL_NEEDS_HOST_OPENSSL=y

# 内核需要的设备固件
BR2_PACKAGE_LINUX_FIRMWARE=y
BR2_PACKAGE_LINUX_FIRMWARE_ATHEROS_9170=y
BR2_PACKAGE_LINUX_FIRMWARE_ATHEROS_9271=y
BR2_PACKAGE_LINUX_FIRMWARE_IWLWIFI_3160=y
BR2_PACKAGE_LINUX_FIRMWARE_IWLWIFI_3168=y
BR2_PACKAGE_LINUX_FIRMWARE_IWLWIFI_5000=y
BR2_PACKAGE_LINUX_FIRMWARE_IWLWIFI_6000G2A=y
BR2_PACKAGE_LINUX_FIRMWARE_IWLWIFI_6000G2B=y
BR2_PACKAGE_LINUX_FIRMWARE_IWLWIFI_7260=y
BR2_PACKAGE_LINUX_FIRMWARE_IWLWIFI_7265D=y
BR2_PACKAGE_LINUX_FIRMWARE_IWLWIFI_8000C=y
BR2_PACKAGE_LINUX_FIRMWARE_IWLWIFI_8265=y
BR2_PACKAGE_LINUX_FIRMWARE_RALINK_RT73=y
BR2_PACKAGE_LINUX_FIRMWARE_RALINK_RT2XX=y
BR2_PACKAGE_LINUX_FIRMWARE_RTL_8169=y
BR2_PACKAGE_LINUX_FIRMWARE_RTL_81XX=y
BR2_PACKAGE_LINUX_FIRMWARE_RTL_87XX=y
BR2_PACKAGE_LINUX_FIRMWARE_RTL_88XX=y

# 软件包
#
# 启用和busybox重复的功能
BR2_PACKAGE_BUSYBOX_SHOW_OTHERS=y

# 使用 connman 是因为它设置网络很简单.
# acpid 用作电源按键支持
BR2_PACKAGE_ACPID=y
BR2_PACKAGE_CONNMAN=y
BR2_PACKAGE_CONNMAN_CLIENT=y
BR2_PACKAGE_CONNMAN_WIFI=y
```
